## submissions/01-chaiklang/wamr/sdkconfig.defaults
```kconfig
# ChaiKlang WAMR host — ESP32-S3 (e.g. Guition JC3248W535).
CONFIG_IDF_TARGET="esp32s3"

# USB-Serial-JTAG console (S3 native USB).
CONFIG_ESP_CONSOLE_USB_SERIAL_JTAG=y

# 8MB flash + OPI PSRAM (wasm linear memory lands here).
CONFIG_ESPTOOLPY_FLASHSIZE_8MB=y
CONFIG_ESPTOOLPY_FLASHMODE_QIO=y
CONFIG_SPIRAM=y
CONFIG_SPIRAM_MODE_OCT=y
CONFIG_SPIRAM_SPEED_80M=y
CONFIG_SPIRAM_USE_MALLOC=y
CONFIG_SPIRAM_MALLOC_ALWAYSINTERNAL=8192
CONFIG_SPIRAM_TRY_ALLOCATE_WHEN_FAILS=y

CONFIG_ESP_MAIN_TASK_STACK_SIZE=16384
CONFIG_PARTITION_TABLE_SINGLE_APP_LARGE=y

# WAMR: our wasm has ZERO imports → no WASI (also avoids WAMR espidf_file.c POSIX gaps on IDF v6).
CONFIG_WAMR_ENABLE_LIBC_WASI=n
# zig/LLVM emits ref-types encoding even for plain tables → enable, else load fails.
CONFIG_WAMR_ENABLE_REF_TYPES=y
# Classic interpreter (fast-interp overflows on big functions; ours is tiny but keep parity with the proven rig).
CONFIG_WAMR_INTERP_CLASSIC=y
```
